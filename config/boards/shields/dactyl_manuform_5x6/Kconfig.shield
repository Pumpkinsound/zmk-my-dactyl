## config/boards/shields/dactyl_manuform_5x6/Kconfig.shield
```kconfig
# Left half
config SHIELD_DACTYL_MANUFORM_5X6_LEFT
    def_bool $(shields_list_contains,dactyl_manuform_5x6_left)

# Right half
config SHIELD_DACTYL_MANUFORM_5X6_RIGHT
    def_bool $(shields_list_contains,dactyl_manuform_5x6_right)
```
